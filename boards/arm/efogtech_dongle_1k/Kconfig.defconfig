## boards/arm/efogtech_dongle_1k/Kconfig.defconfig
```kconfig
if BOARD_EFOGTECH_DONGLE_1K

config BOARD
    default "efogtech_dongle_1k"

if USB

config USB_NRFX
    default y

config USB_DEVICE_STACK
    default y

endif # USB

config BT_CTLR
    default BT

endif # BOARD_EFOGTECH_DONGLE_1K
```

## config/boards/shields/simple34/Kconfig.defconfig
```kconfig
if SHIELD_SIMPLE34_DONGLE

config ZMK_KEYBOARD_NAME
	default "simple34 Dongle"
	
config ZMK_SPLIT_BLE_ROLE_CENTRAL
	default y
	
config ZMK_USB
	default y

endif

if SHIELD_SIMPLE34_LEFT_CENTRAL

config ZMK_KEYBOARD_NAME
	default "simple34 Left"

config ZMK_SPLIT_BLE_ROLE_CENTRAL
	default y

config ZMK_USB
	default y

endif

if SHIELD_SIMPLE34_LEFT || SHIELD_SIMPLE34_LEFT_CENTRAL || SHIELD_SIMPLE34_RIGHT || SHIELD_SIMPLE34_DONGLE 

config ZMK_SPLIT
	default y

config ZMK_BLE
	default y
	
endif
```

## config/boards/shields/simple34/Kconfig.shield
```kconfig
config SHIELD_SIMPLE34_LEFT
	def_bool $(shields_list_contains,simple34_left)

config SHIELD_SIMPLE34_RIGHT
	def_bool $(shields_list_contains,simple34_right)

config SHIELD_SIMPLE34_DONGLE
	def_bool $(shields_list_contains,simple34_dongle)

config SHIELD_SIMPLE34_LEFT_CENTRAL
	def_bool $(shields_list_contains,simple34_left_central)
```

## config/modules/layer-leds/Kconfig
```kconfig
config ZMK_LAYER_LED_INDICATORS
    bool "Layer LED indicators (GPIO)"
    default y
    depends on DT_HAS_ZMK_LAYER_LED_INDICATORS_ENABLED
    depends on GPIO

config ZMK_LAYER_LED_SYNC
    bool "Sync layer state to split peripherals via BLE"
    default y
    depends on ZMK_SPLIT
    depends on ZMK_BLE

config ZMK_LAYER_LED_BOOT_BLINK
    bool "Flash LEDs on power-on / wake from sleep"
    default y
    depends on ZMK_LAYER_LED_INDICATORS

config ZMK_LAYER_LED_BLINK_COUNT
    int "Number of power-on/wake LED blinks"
    default 3
    range 1 10
    depends on ZMK_LAYER_LED_BOOT_BLINK

config ZMK_LAYER_LED_BLINK_DELAY_MS
    int "Delay between power-on/wake blink phases (ms)"
    default 90
    range 10 1000
    depends on ZMK_LAYER_LED_BOOT_BLINK
```

## config/modules/layer-leds/dts/bindings/behaviors/zmk,behavior-hrm-key-press.yaml
```yaml
description: |
  Key press that also toggles the home-row-mod inner LED on a split half.
  Used as the hold binding of hold-tap HRMs.

compatible: "zmk,behavior-hrm-key-press"

include: one_param.yaml

properties:
  side:
    type: int
    required: true
    description: |
      Half that owns this HRM: 0 = left, 1 = right.
```

## config/modules/layer-leds/dts/bindings/zmk,layer-led-indicators.yaml
```yaml
description: |
  GPIO LEDs driven by ZMK layer state.
  Each entry in layer-state is a bitmask indicating which LEDs
  are on when that layer is the highest active layer.
  Bit 0 corresponds to the first GPIO in led-gpios, bit 1 to the second, etc.

compatible: "zmk,layer-led-indicators"

properties:
  led-gpios:
    type: phandle-array
    required: true
    description: |
      Array of GPIO specs for each LED output.

  layer-state:
    type: array
    required: true
    description: |
      Array of bitmasks, one per layer index (starting at layer 0).
      Each bitmask encodes which LEDs are on for that layer.
      Example for 2 LEDs, 4 layers:
        layer-state = <0x00 0x01 0x02 0x03>;
        Layer 0: 0b00 -> both off
        Layer 1: 0b01 -> LED0 on
        Layer 2: 0b10 -> LED1 on
        Layer 3: 0b11 -> both on
```
