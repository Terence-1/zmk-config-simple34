## boards/shields/simple34_test/Kconfig.defconfig
```kconfig
if SHIELD_SIMPLE34_TEST_LEFT

config ZMK_KEYBOARD_NAME
    default "Simple34 Test Left"

endif

if SHIELD_SIMPLE34_TEST_RIGHT

config ZMK_KEYBOARD_NAME
    default "Simple34 Test Right"

endif

if SHIELD_SIMPLE34_TEST_LEFT || SHIELD_SIMPLE34_TEST_RIGHT

config ZMK_BLE
    default y

endif
```

## boards/shields/simple34_test/Kconfig.shield
```kconfig
config SHIELD_SIMPLE34_TEST_LEFT
    def_bool $(shields_list_contains,simple34_test_left)

config SHIELD_SIMPLE34_TEST_RIGHT
    def_bool $(shields_list_contains,simple34_test_right)
```

## config/west.yml
```yaml
manifest:
  defaults:
    revision: v0.3
  remotes:
    - name: zmkfirmware
      url-base: https://github.com/zmkfirmware
    - name: Terence-1
      url-base: https://github.com/Terence-1
  projects:
    - name: zmk
      remote: zmkfirmware
      import: app/west.yml
    - name: zmk-usb-reporting
      remote: Terence-1
      revision: main
  self:
    path: config
```
